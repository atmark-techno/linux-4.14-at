/*
 * Copyright (C) 2018 Atmark Techno, Inc. All Rights Reserved.
 *
 * SPDX-License-Identifier: (GPL-2.0 OR MIT)
 */

/dts-v1/;

#define ARMADILLO640_AT_DTWEB
#include "armadillo-640.dts"
#include "armadillo-640-expansion-interface.dtsi"
