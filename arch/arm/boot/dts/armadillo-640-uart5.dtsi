/*
 * Copyright (C) 2018 Atmark Techno, Inc. All Rights Reserved.
 *
 * SPDX-License-Identifier: (GPL-2.0 OR MIT)
 */

&uart5 {
	pinctrl-names = "default";
	pinctrl-0 = <&pinctrl_uart5>;
	status = "okay";
};

&iomuxc {
	pinctrl_uart5: uart5grp {
		fsl,pins = <
			MX6UL_PAD_UART5_TX_DATA__UART5_DCE_TX 0x00008
			MX6ULL_PAD_UART5_RX_DATA__UART5_DCE_RX 0x1b0b1
		>;
	};
};
